/*********************************************************************************************************************
* 文件名称          Motor
* 功能简介          电机模块（左右两个驱动电机）
*
* 引脚（和学长工程一致，来自 main.c 里的定义）：
*   按单轮实测修正后：左电机由 D3/D2 输出，右电机由 C11/C10 输出。
*
* 每个电机用两路 PWM：一路正转、一路反转，另一路给 0。
* 这样比"一路 PWM + 一路方向 IO"更好，因为支持刹车，而且不用额外的 IO。
********************************************************************************************************************/

#include "Motor.h"

#define MOTOR_LEFT_PWM_FWD      (PWM2_MODULE3_CHB_D3)   // 实测：此输出驱动车体左轮
#define MOTOR_LEFT_PWM_REV      (PWM2_MODULE3_CHA_D2)   // 左轮反转
#define MOTOR_RIGHT_PWM_FWD     (PWM2_MODULE2_CHB_C11)  // 实测：此输出驱动车体右轮
#define MOTOR_RIGHT_PWM_REV     (PWM2_MODULE2_CHA_C10)  // 右轮反转

#define MOTOR_PWM_FREQ          (17000)                 // 电机 PWM 频率 17kHz（学长用的经验值，避开电磁干扰）

//-------------------------------------------------------------------------------------------------------------------
// 如果实测发现某个轮子的转向和预期相反，把对应的这个改成 (-1) 即可，不用去改接线
//   左轮向前转应该让车前进，如果反了就设 MOTOR_LEFT_SIGN = -1
//   【实车标定 2026-10-04】实测: 给正值时两个轮子都倒转（车往后跑），
//   所以左右都改成 -1，现在给正值 = 车往前跑。
//-------------------------------------------------------------------------------------------------------------------
#define MOTOR_LEFT_SIGN         (-1)
#define MOTOR_RIGHT_SIGN        (-1)

//-------------------------------------------------------------------------------------------------------------------
// 函数简介     电机初始化
//-------------------------------------------------------------------------------------------------------------------
void Motor_Init(void)
{
    pwm_init(MOTOR_LEFT_PWM_FWD,  MOTOR_PWM_FREQ, 0);
    pwm_init(MOTOR_LEFT_PWM_REV,  MOTOR_PWM_FREQ, 0);
    pwm_init(MOTOR_RIGHT_PWM_FWD, MOTOR_PWM_FREQ, 0);
    pwm_init(MOTOR_RIGHT_PWM_REV, MOTOR_PWM_FREQ, 0);

    Motor_Stop();
}

//-------------------------------------------------------------------------------------------------------------------
// 函数简介     设置左轮
//-------------------------------------------------------------------------------------------------------------------
void Motor_SetLeft(int duty)
{
    duty *= MOTOR_LEFT_SIGN;

    if(duty >  MOTOR_DUTY_MAX) { duty =  MOTOR_DUTY_MAX; }
    if(duty < -MOTOR_DUTY_MAX) { duty = -MOTOR_DUTY_MAX; }

    if(duty >= 0)
    {
        pwm_set_duty(MOTOR_LEFT_PWM_FWD, (uint32)duty);
        pwm_set_duty(MOTOR_LEFT_PWM_REV, 0);
    }
    else
    {
        pwm_set_duty(MOTOR_LEFT_PWM_FWD, 0);
        pwm_set_duty(MOTOR_LEFT_PWM_REV, (uint32)(-duty));
    }
}

//-------------------------------------------------------------------------------------------------------------------
// 函数简介     设置右轮
//-------------------------------------------------------------------------------------------------------------------
void Motor_SetRight(int duty)
{
    duty *= MOTOR_RIGHT_SIGN;

    if(duty >  MOTOR_DUTY_MAX) { duty =  MOTOR_DUTY_MAX; }
    if(duty < -MOTOR_DUTY_MAX) { duty = -MOTOR_DUTY_MAX; }

    if(duty >= 0)
    {
        pwm_set_duty(MOTOR_RIGHT_PWM_FWD, (uint32)duty);
        pwm_set_duty(MOTOR_RIGHT_PWM_REV, 0);
    }
    else
    {
        pwm_set_duty(MOTOR_RIGHT_PWM_FWD, 0);
        pwm_set_duty(MOTOR_RIGHT_PWM_REV, (uint32)(-duty));
    }
}

//-------------------------------------------------------------------------------------------------------------------
// 函数简介     同时设置左右轮
//-------------------------------------------------------------------------------------------------------------------
void Motor_Set(int left, int right)
{
    Motor_SetLeft(left);
    Motor_SetRight(right);
}

//-------------------------------------------------------------------------------------------------------------------
// 函数简介     停车
//-------------------------------------------------------------------------------------------------------------------
void Motor_Stop(void)
{
    Motor_Set(0, 0);
}
